## config/west.yml
```yaml
manifest:
  remotes:
    - name: chase-hunter
      url-base: https://github.com/chase-hunter
    - name: petejohanson
      url-base: https://github.com/petejohanson
    - name: gpeye
      url-base: https://github.com/GPeye
  projects:
    - name: eyelash_sofle
      url: https://github.com/a741725193/zmk-sofle
      revision: refactor
    - name: zmk
      remote: petejohanson
      revision: feat/pointers-with-input-processors
      import: app/west.yml
    - name: mario-peripheral-animation
    # - name: urchin-peripheral-animation
      remote: gpeye
      revision: main
  self:
    path: config
```
